## boards/shields/siren_song/Kconfig.defconfig
```kconfig
if SHIELD_SIREN_SONG_LEFT

config ZMK_KEYBOARD_NAME
    default "Siren Song"

config ZMK_SPLIT_ROLE_CENTRAL
    default y

endif

if SHIELD_SIREN_SONG_RIGHT

config ZMK_SPLIT_ROLE_CENTRAL
    default n

endif

if SHIELD_SIREN_SONG_LEFT || SHIELD_SIREN_SONG_RIGHT

config ZMK_SPLIT
    default y

endif
```

## boards/shields/siren_song/Kconfig.shield
```kconfig
config SHIELD_SIREN_SONG_LEFT
    def_bool $(shields_list_contains,siren_song_left)

config SHIELD_SIREN_SONG_RIGHT
    def_bool $(shields_list_contains,siren_song_right)
```
